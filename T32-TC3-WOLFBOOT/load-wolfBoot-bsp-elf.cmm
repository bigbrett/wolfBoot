; Loads wolf BSP version of wolfBoot for tricore with the ELF loading memory map

system.down
system.up


LOCAL &wolfBoot &testApp &updateApp
&wolfBoot="../wolfboot.elf"
&testApp="../test-app/image_v1_signed.bin"
&updateApp="../test-app/image_v2_signed.bin"

DO  ~~/demo/tricore/flash/tc37x.cmm PREPAREONLY
flash.CHANGEtype 0xA0000000--0xA009FFFF NOP
flash.CHANGEtype 0x80000000--0x8009FFFF NOP

flash.erase all

flash.reprogram all /erase
data.load.binary "&testApp" 0xA047C000
data.load.binary "&updateApp" 0xA053C000
data.load.elf "&wolfBoot"
flash.reprogram off

break.set tc3tc_main

system.down
system.up
;go

; Bring up the important views
SYStem
Frame /Locals /Caller
List


