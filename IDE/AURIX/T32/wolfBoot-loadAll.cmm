system.down
system.up


LOCAL &wolfBoot &testAppElf &testAppBin
&wolfBoot="..\tc3xx\TriCore Debug (GCC)\wolfBoot-tc3xx.elf"
&testAppBin="..\test-app\TriCore Debug (GCC)\test-app_v1_signed.bin"
;&updateApp="..\test-app-update\TriCore Debug (GCC)\test-app-update_v2_signed.bin"
&updateApp="..\test-app\TriCore Debug (GCC)\test-app_v2_signed.bin"

DO  ~~/demo/tricore/flash/tc37x.cmm PREPAREONLY

; Uncomment when HSM is active
; flash.CHANGEtype 0xA0004000--0xA0007FFF NOP

; BODGE: manually use /fill to write 0s to erased memory to fix ECC errors

flash.erase all

flash.reprogram all /erase
data.load.binary "&testAppBin" 0xA0300000
data.load.binary "&updateApp" 0xA0480000
data.load.elf "&wolfBoot"
flash.reprogram off

break.set core0_main

system.down
system.up
go

; Bring up the important views
SYStem
Frame /Locals /Caller
List


