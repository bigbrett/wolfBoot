system.down
system.up


LOCAL &wolfBoot &testApp
&wolfBoot="..\TriCore Debug (GCC)\wolfBoot-tc3xx.elf"
&testApp="..\..\test-app\TriCore Debug (GCC)\test-app.elf"

DO  ~~/demo/tricore/flash/tc37x.cmm PREPAREONLY

; Uncomment when HSM is active
; flash.CHANGEtype 0xA0004000--0xA0007FFF NOP

; erase flash (get rid of this when HSM is active)


flash.reprogram all /erase
data.load.elf "&testApp"
data.load.elf "&wolfBoot"
flash.reprogram off

break.set core0_main


system.down
system.up
go

; Bring up the important views
SYStem
Frame /Locals /Caller
List


