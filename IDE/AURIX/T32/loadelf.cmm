system.down
system.up

PARAMETERS &elfFile

PRINT "Using ELF File: &elfFile"

DO  ~~/demo/tricore/flash/tc37x.cmm PREPAREONLY

flash.reprogram all /erase /fill
data.load.elf "&elfFile"
flash.reprogram off

break.set core0_main

system.down
system.up
go

; Bring up the important views
SYStem
Frame /Locals /Caller
List


