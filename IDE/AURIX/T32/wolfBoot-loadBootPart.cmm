system.down
system.up


LOCAL &elfFile
&elfFile="..\test-app\TriCore Debug (GCC)\test-app.elf"
PRINT "Using ELF File: &elfFile"


DO  ~~/demo/tricore/flash/tc37x.cmm PREPAREONLY

; Uncomment when HSM is active
; flash.CHANGEtype 0xA0004000--0xA0007FFF NOP

; Protect wolfBoot sectors
;flash.CHANGEtype 0xA0000000--0xA007FFFF NOP

; erase flash (get rid of this when HSM is active)


flash.reprogram all /erase ;/fill
data.load.elf "&elfFile"
flash.reprogram off

break.set core0_main


system.down
system.up

break.set hal_flash_write

go

; Bring up the important views
SYStem
Frame /Locals /Caller
List


